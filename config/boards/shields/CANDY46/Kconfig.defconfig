## config/boards/shields/CANDY46/Kconfig.defconfig
```kconfig
if SHIELD_CANDY46_LEFT

    config ZMK_KEYBOARD_NAME
        default "CANDY46-L"

    config ZMK_SPLIT_BLE_ROLE_CENTRAL
        default y

endif

if SHIELD_CANDY46_RIGHT

    config ZMK_KEYBOARD_NAME
        default "CANDY46-R"

endif

if SHIELD_CANDY46_LEFT || SHIELD_CANDY46_RIGHT

    config ZMK_SPLIT
        default y

endif
```

## config/boards/shields/ForScience/Kconfig.defconfig
```kconfig
if SHIELD_FORSCIENCE_LEFT

    config ZMK_KEYBOARD_NAME
        default "ForScience-L"

    config ZMK_SPLIT_BLE_ROLE_CENTRAL
        default y

endif

if SHIELD_FORSCIENCE_RIGHT

    config ZMK_KEYBOARD_NAME
        default "ForScience-R"

endif

if SHIELD_FORSCIENCE_LEFT || SHIELD_FORSCIENCE_RIGHT

    config ZMK_SPLIT
        default y

endif
```

## config/boards/shields/ForScience/Kconfig.shield
```kconfig
config SHIELD_FORSCIENCE_LEFT
    def_bool $(shields_list_contains,ForScience_left)

config SHIELD_FORSCIENCE_RIGHT
    def_bool $(shields_list_contains,ForScience_right)

config SHIELD_CRADIO_DONGLE
    def_bool $(shields_list_contains,cradio_dongle)
```

## config/boards/shields/zwactyl_50/Kconfig.defconfig
```kconfig
if SHIELD_ZWACTYL_50_LEFT

    config ZMK_KEYBOARD_NAME
        default "zwactyl_50(Left)"

    config ZMK_SPLIT_BLE_ROLE_CENTRAL
        default y

endif

if SHIELD_ZWACTYL_50_RIGHT

    config ZMK_KEYBOARD_NAME
        default "zwactyl_50(Right)"

endif

if SHIELD_ZWACTYL_50_LEFT || SHIELD_ZWACTYL_50_RIGHT

    config ZMK_SPLIT
        default y

endif
```

## config/boards/shields/zwactyl_50/Kconfig.shield
```kconfig
config SHIELD_ZWACTYL_50_LEFT
    def_bool $(shields_list_contains,zwactyl_50_left)

config SHIELD_ZWACTYL_50_RIGHT
    def_bool $(shields_list_contains,zwactyl_50_right)
```
